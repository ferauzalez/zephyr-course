## app/boards/another_board/board.yml
```yaml
board:
  name: another_board
  full_name: Another board by Fernando
  vendor: fernando-electronics
  socs:
    - name: stm32f401xe
```

## app/boards/nucleo_ferna/board.yml
```yaml
board:
  name: nucleo_ferna
  full_name: Nucleo F401RE de Fernando
  vendor: fernando
  socs:
    - name: stm32f401xe
```
